## main/Kconfig.projbuild
```kconfig
menu "WiFi Configuration"

    choice WIFI_MODE
        prompt "WiFi Mode"
        default WIFI_AP
        help
            Select WiFi as a software AP or as a station connect to a AP.
    
    config WIFI_AP
        bool "WiFi Software AP"
    
    config WIFI_STA
        bool "WiFi Station"
    
    endchoice

    config ESP_WIFI_SSID
        string "WiFi SSID"
        default "myssid"
        help
            SSID (network name) for the example to connect to.

    config ESP_WIFI_PASSWORD
        string "WiFi Password"
        default "mypassword"
        help
            WiFi password (WPA or WPA2) for the example to use.

    config ESP_MAX_STA_CONN
        int "Maximal STA connections"
        depends on WIFI_AP
        default 4
        help
            Max number of the STA connects to AP.
        
    config ESP_MAXIMUM_RETRY
        int "Maximum retry"
        depends on WIFI_STA
        default 5
        help
            Set the Maximum retry to avoid station reconnecting to the AP unlimited when the AP is really inexistent.

endmenu
```

## sdkconfig.defaults
```kconfig
CONFIG_ESPTOOLPY_FLASHMODE_QIO=y
CONFIG_ESPTOOLPY_FLASHFREQ_80M=y
CONFIG_ESPTOOLPY_FLASHSIZE_4MB=y
CONFIG_RTCIO_SUPPORT_RTC_GPIO_DESC=y
CONFIG_ESP32_DEFAULT_CPU_FREQ_240=y
CONFIG_ESP32_SPIRAM_SUPPORT=y
CONFIG_SPIRAM_BOOT_INIT=y
CONFIG_SPIRAM_IGNORE_NOTFOUND=y
CONFIG_ESP32_XTAL_FREQ_AUTO=y
```
